/* corne_nice.overlay */

/* 1) Include the Corne .dtsi that lives right alongside this file */
#include "corne.dtsi"

/* 2) Tell ZMK which scanner node to use */
/
{
    chosen {
        zmk,kscan = &kscan0;
    };
};

/* 3) Patch the existing &kscan0 node for Nice!Nano v2 pins */
&kscan0 {
    compatible = "zmk,kscan-gpio-matrix";
    diode-direction = "col2row";

    /* 4 rows on Nice!Nano v2 header */
    row-gpios = <
        &gpio0 10 (GPIO_ACTIVE_HIGH | GPIO_PULL_DOWN)
        &gpio0  9 (GPIO_ACTIVE_HIGH | GPIO_PULL_DOWN)
        &gpio0 24 (GPIO_ACTIVE_HIGH | GPIO_PULL_DOWN)
        &gpio1  0 (GPIO_ACTIVE_HIGH | GPIO_PULL_DOWN)
    >;

    /* 10 columns on Nice!Nano v2 header */
    col-gpios = <
        &gpio0 31 GPIO_ACTIVE_HIGH
        &gpio0 29 GPIO_ACTIVE_HIGH
        &gpio0  2 GPIO_ACTIVE_HIGH
        &gpio1 15 GPIO_ACTIVE_HIGH
        &gpio1 13 GPIO_ACTIVE_HIGH
        &gpio1 11 GPIO_ACTIVE_HIGH
        &gpio0  6 GPIO_ACTIVE_HIGH
        &gpio0  8 GPIO_ACTIVE_HIGH
        &gpio0 17 GPIO_ACTIVE_HIGH
        &gpio0 20 GPIO_ACTIVE_HIGH
        &gpio0 22 GPIO_ACTIVE_HIGH
    >;
};
